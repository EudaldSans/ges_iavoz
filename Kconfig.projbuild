## Kconfig.projbuild
```kconfig
menu "SIMON IAVOZ"
    config IAVOZ_ENABLE
        bool "Enable IAVOZ service"
        default n

    config IAVOZ_SYS_TASK_STACK_SIZE
        depends on IAVOZ_ENABLE
        int "Underlying IAVOZ system task stack size"
        range 1024 32768
        default 7168
        help
            The stack size of the IAVOZ's system management underlying task.
		
    config IAVOZ_SYS_TASK_PRIORITY
        depends on IAVOZ_ENABLE
        int "Underlying task priority"
        range 3 25
        default 5
        help
            The priority of the IAVOZ's system management underlying task.


    config IAVOZ_MIC_TASK_STACK_SIZE
        depends on IAVOZ_ENABLE
        int "Underlying task stack size"
        range 1024 32768
        default 7168
        help
            The stack size of the microphone's management underlying task.
		
    config IAVOZ_MIC_TASK_PRIORITY
        depends on IAVOZ_ENABLE
        int "Underlying task priority"
        range 3 25
        default 5
        help
            The priority of the microphone's management underlying task.

    config IAVOZ_MIC_I2S_NUM
        depends on IAVOZ_ENABLE
        int "I2S peripheral num"
        range 0 1
        default 1
        help
            The I2S peripheral to be used by the system.
    
    config IAVOZ_MIC_I2S_PIN_BCK
        depends on IAVOZ_ENABLE
        int "I2S clock pin"
        range 0 40
        default 13
        help
            The I2S pin used for clock signal.

    config IAVOZ_MIC_I2S_PIN_WS
        depends on IAVOZ_ENABLE
        int "I2S word-select pin"
        range 0 40
        default 0
        help
            The I2S pin used for word-select signal.

    config IAVOZ_MIC_I2S_PIN_DIN
        depends on IAVOZ_ENABLE
        int "I2S data pin"
        range 0 40
        default 22
        help
            The I2S pin used for data signal.

endmenu


menu "Connect configuration"

    config ESP_WIFI_SSID
        string "WiFi SSID"
        default "MiFibra-D53F"
        help 
            SSID (network name) for the device to connect to.

    config ESP_WIFI_PASSWORD
        string "WiFi Password"
        default "GSVCp2Ya"
        help
            WiFi password (WPA or WPA2) for the device to use.

    config ESP_MAXIMUM_RETRY
        int "Maximum retry"
        default 5
        help
            Set the Maximum retry to avoid station reconnecting to the AP unlimited when the AP is really inexistent.

    choice ESP_WIFI_SCAN_AUTH_MODE_THRESHOLD
        prompt "WiFi Scan auth mode threshold"
        default ESP_WIFI_AUTH_OPEN
        help
            The weakest authmode to accept in the scan mode.

        config ESP_WIFI_AUTH_OPEN
            bool "OPEN"
        config ESP_WIFI_AUTH_WEP
            bool "WEP"
        config ESP_WIFI_AUTH_WPA_PSK
            bool "WPA PSK"
        config ESP_WIFI_AUTH_WPA2_PSK
            bool "WPA2 PSK"
        config ESP_WIFI_AUTH_WPA_WPA2_PSK
            bool "WPA/WPA2 PSK"
        config ESP_WIFI_AUTH_WPA3_PSK
            bool "WPA3 PSK"
        config ESP_WIFI_AUTH_WPA2_WPA3_PSK
            bool "WPA2/WPA3 PSK"
        config ESP_WIFI_AUTH_WAPI_PSK
            bool "WAPI PSK"
    endchoice

endmenu
```

## components/ges_iavoz/Kconfig.projbuild
```kconfig
menu "SIMON IAVOZ"
    config IAVOZ_ENABLE
        bool "Enable IAVOZ service"
        default n

    config IAVOZ_SYS_TASK_STACK_SIZE
        depends on IAVOZ_ENABLE
        int "Underlying IAVOZ system task stack size"
        range 1024 32768
        default 7168
        help
            The stack size of the IAVOZ's system management underlying task.
		
    config IAVOZ_SYS_TASK_PRIORITY
        depends on IAVOZ_ENABLE
        int "Underlying task priority"
        range 3 25
        default 5
        help
            The priority of the IAVOZ's system management underlying task.


    config IAVOZ_MIC_TASK_STACK_SIZE
        depends on IAVOZ_ENABLE
        int "Underlying task stack size"
        range 1024 32768
        default 7168
        help
            The stack size of the microphone's management underlying task.
		
    config IAVOZ_MIC_TASK_PRIORITY
        depends on IAVOZ_ENABLE
        int "Underlying task priority"
        range 3 25
        default 5
        help
            The priority of the microphone's management underlying task.

    config IAVOZ_MIC_I2S_NUM
        depends on IAVOZ_ENABLE
        int "I2S peripheral num"
        range 0 1
        default 1
        help
            The I2S peripheral to be used by the system.
    
    config IAVOZ_MIC_I2S_PIN_BCK
        depends on IAVOZ_ENABLE
        int "I2S clock pin"
        range 0 40
        default 13
        help
            The I2S pin used for clock signal.

    config IAVOZ_MIC_I2S_PIN_WS
        depends on IAVOZ_ENABLE
        int "I2S word-select pin"
        range 0 40
        default 0
        help
            The I2S pin used for word-select signal.

    config IAVOZ_MIC_I2S_PIN_DIN
        depends on IAVOZ_ENABLE
        int "I2S data pin"
        range 0 40
        default 22
        help
            The I2S pin used for data signal.

endmenu
```

## sdkconfig.defaults
```kconfig
# Copyright 2020 The TensorFlow Authors. All Rights Reserved.
#
# Licensed under the Apache License, Version 2.0 (the "License");
# you may not use this file except in compliance with the License.
# You may obtain a copy of the License at
#
#     http://www.apache.org/licenses/LICENSE-2.0
#
# Unless required by applicable law or agreed to in writing, software
# distributed under the License is distributed on an "AS IS" BASIS,
# WITHOUT WARRANTIES OR CONDITIONS OF ANY KIND, either express or implied.
# See the License for the specific language governing permissions and
# limitations under the License.

CONFIG_ESP32_DEFAULT_CPU_FREQ_MHZ=240
CONFIG_FLASHMODE_QIO=y
CONFIG_ESPTOOLPY_FLASHFREQ_80M=y
CONFIG_INT_WDT=
CONFIG_TASK_WDT=
CONFIG_COMPILER_OPTIMIZATION_PERF=y

#
# SIMON IAVOZ
#
CONFIG_IAVOZ_ENABLE=y
CONFIG_IAVOZ_SYS_TASK_STACK_SIZE=7168
CONFIG_IAVOZ_SYS_TASK_PRIORITY=5
CONFIG_IAVOZ_MIC_TASK_STACK_SIZE=7168
CONFIG_IAVOZ_MIC_TASK_PRIORITY=5
CONFIG_IAVOZ_MIC_I2S_NUM=1
CONFIG_IAVOZ_MIC_I2S_PIN_BCK=13
CONFIG_IAVOZ_MIC_I2S_PIN_WS=0
CONFIG_IAVOZ_MIC_I2S_PIN_DIN=22
```
